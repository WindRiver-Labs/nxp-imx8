## conf/layer.conf
```bitbake
#
# Copyright (C) 2016-2020 Wind River Systems, Inc.
#

# We have a conf and classes directory, add to BBPATH
BBPATH =. "${LAYERDIR}:"

# We have a packages directory, add to BBFILES
BBFILES += "${LAYERDIR}/recipes-*/*/*.bb \
	${LAYERDIR}/recipes-*/*/*.bbappend \
	${LAYERDIR}/classes/*.bbclass"

BBFILE_COLLECTIONS += "wr-nxp-imx8"
BBFILE_PATTERN_wr-nxp-imx8 := "^${LAYERDIR}/"
BBFILE_PRIORITY_wr-nxp-imx8 = "7"

# This should only be incremented on significant changes that will
# cause compatibility issues with other layers
LAYERVERSION_wr-nxp-imx8 = "1"

LAYERSERIES_COMPAT_wr-nxp-imx8 = "wrl hardknott"
LAYERDEPENDS_wr-nxp-imx8 = "core wrlinux"
LAYERRECOMMENDS_wr-nxp-imx8 = "nxp-imx8-dl"
```

## conf/machine/nxp-imx8.conf
```bitbake
#@TYPE: Machine
#@NAME: nxp-imx8
#@DESCRIPTION: nxp-imx8

DEFAULTTUNE = "aarch64"
require conf/machine/include/arm/arch-armv8a.inc

MACHINE_FEATURES = "ext3 pci usbgadget usbhost vfat alsa"

DISTRO_FEATURES_append = " wifi bluetooth pci"

KERNEL_IMAGETYPE = ""
KERNEL_IMAGETYPES = "Image.gz Image"
KERNEL_DEVICETREE = "freescale/imx8qm-mek.dtb freescale/imx8qm-mek-dsi-rm67191.dtb freescale/imx8qm-mek-ov5640.dtb freescale/imx8qm-mek-hdmi.dtb"

SERIAL_CONSOLE = "115200 ttyLF0"
SERIAL_CONSOLES_CHECK ?= "${SERIAL_CONSOLES}"

MULTILIBS ?= "multilib:lib32"
DEFAULTTUNE_virtclass-multilib-lib32 ?= "armv7athf-neon"

WKS_FILE ?= "sdimage-ubootheader-imx8.wks"
do_image_wic[depends] += "mtools-native:do_populate_sysroot dosfstools-native:do_populate_sysroot"

PREFERRED_PROVIDER_virtual/kernel ??= "linux-yocto"
PREFERRED_VERSION_linux-yocto ?= "5.10%"

MACHINE_EXTRA_RRECOMMENDS = " kernel-modules kernel-devicetree linux-firmware-ath10k linux-firmware-imx-sdma-imx7d"
IMAGE_FSTYPES += "tar.bz2 wic wic.bmap"
IMAGE_INSTALL_append = " kernel-devicetree kernel-image-image"

IMAGE_BOOT_FILES ?= "Image imx8qm-mek.dtb imx8qm-mek-hdmi.dtb imx8qm-mek-ov5640.dtb imx8qm-mek-dsi-rm67191.dtb"

MACHINE_SOCARCH = "nxp_imx8"

# For ostree
# The loader is flashed into the device separately and not part of the SD image
# No u-boot
OSTREE_BOOTLOADER_INCLUDE ?= ""
OSTREE_SD_UBOOT_WIC1 ?= ""
OSTREE_SD_UBOOT_WIC2 ?= ""
OSTREE_SD_UBOOT_WIC3 ?= ""
OSTREE_SD_UBOOT_WIC4 ?= ""
OSTREE_SD_BOOT_ALIGN ?= "10240"
OSTREE_WKS_EFI_SIZE ?= "--size=64M"
OSTREE_FDISK_BLM ?= "20480"
# Because of the size of the offset being 20480 which is ~10M, 10 must be added
# to 64
OSTREE_FDISK_FSZ ?= "74"
OSTREE_UBOOT_CMD ?= "booti"

OSTREE_BOOTSCR_PRECMD ?= " \
setenv no_menu yes; \
if test ! -n \${devnum}; then setenv devnum 1; fi; \
setenv initrd_addr 0x98000000; \
"

INITRAMFS_IMAGE ??= ""
IMAGE_BOOT_FILES_append = " ${@bb.utils.contains('DISTRO_FEATURES', 'ostree', '${INITRAMFS_IMAGE}-${MACHINE}.${INITRAMFS_FSTYPES};initramfs boot.scr', '', d)} \
"
OSTREE_KERNEL ?= "Image"
DEFAULT_DTB ?= "imx8qm-mek.dtb"
OSTREE_COPY_IMAGE_BOOT_FILES = "1"
OSTREE_UBOOT_CMD ?= "booti"
OSTREE_WKS_EFI_SIZE ?= "--size=64M"

# For ustart.img
OSTREE_NETINST_DEV ?= "/dev/mmcblk1,/dev/sda,/dev/vda"
OSTREE_NETINST_ARGS ?= "${OSTREE_CONSOLE} bl=ufsd rdinit=/install instdev=${OSTREE_NETINST_DEV} instname=wrlinux instbr=\$BRANCH insturl=\$URL instab=${OSTREE_USE_AB} instsf=1 instdate=BUILD_DATE"
```

## wic/sdimage-ubootheader-imx8.wks
```
part /boot --source bootimg-partition --ondisk mmcblk1 --fstype=vfat --label boot --active --align 10240 --size 64
part / --source rootfs --ondisk mmcblk1 --fstype=ext4 --label root --align 4096
```
